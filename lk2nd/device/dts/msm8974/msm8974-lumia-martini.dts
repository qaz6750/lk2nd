// SPDX-License-Identifier: BSD-3-Clause

#include <skeleton64.dtsi>
#include <lk2nd.dtsi>

/ {
	model = "Microsoft Lumia 930";
	qcom,msm-id = <QCOM_ID_MSM8974 0x96 0x20002 0x0>;
};

&lk2nd {
	model = "Microsoft Lumia 930";
	compatible = "Lumia,Martini";
};
